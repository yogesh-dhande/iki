## plugins/samples/types/sample.yaml
```yaml
# yaml-language-server: $schema=https://ikisci.org/schemas/manifest/v1
apiVersion: iki/v1
kind: EntityType
name: Sample
label: Sample
abstract: true
schema_version: 2
sample: true
description: >-
  A portion drawn from one tube or lot for identified work, with its measurements. Each
  kind of sample is a testing procedure the lab chooses as it creates one.
draws:
  received: receipt
due: due_on
fields:
  source: { type: ref, to: [iki/inventory.Tube, iki/lots.Lot], required: true, immutable: true }
  purpose:
    type: ref
    to: iki/core.Entity
    immutable: true
    description: The request, plate or other work this sample was taken for.
  run:
    type: string
    label: Run
    pattern: "^RUN-[0-9]+$"
    immutable: true
    description: The run this sample was taken for, when the work is an action run.
  receipt: { type: json, computed: true, label: Material draw }
  measurements:
    type: list
    max_items: 200
    items:
      type: row
      fields:
        method: { type: string, required: true, max_length: 150 }
        value:
          {
            type: string,
            required: true,
            max_length: 250,
            description: The observation as reported.,
          }
        unit: { type: string, max_length: 40 }
        notes: { type: text }
  notes: { type: text }
  due_on: { type: date }
rules:
  identified_work:
    check: (record.purpose != null) != (record.run != null)
    message: Identify the work with either a record or a run.
    fields: [purpose, run]
```

## spec/tests/plugins/protein/types/sample.yaml
```yaml
apiVersion: iki/v1
kind: EntityType
name: Sample
label: Sample
schema_version: 1
# Its records are samples (ADR 0177): a project's Files finds files by them.
sample: true
hrid: { prefix: SMP }
# How much of it there is (ADR 0139): drawn by volume, or by mass at its concentration.
amount: { unit: uL, label: Volume, concentration: concentration }
fields:
  label: { type: string, required: true, unique: true, indexed: true, max_length: 200 }
  protein: { type: ref, to: Protein }
  lot: { type: ref, to: Lot }
  # What it's of: a protein or a DNA sequence (ADR 0136).
  material: { type: ref, to: [Protein, acme/dna.DNASequence] }
  purity: { type: float, min: 0, max: 100 }
  concentration: { type: quantity, unit: mg/mL, min: 0 }
  tags: { type: list, items: { type: string, max_length: 40 } }
  # What was added to it, a row each (ADR 0137).
  additions:
    type: list
    max_items: 20
    items:
      type: row
      fields:
        material: { type: ref, to: [Protein, acme/dna.DNASequence], required: true }
        amount: { type: quantity, unit: ug, min: 0 }
        added_on: { type: date }
        note: { type: string, max_length: 200 }
        # Its certificate of analysis: a file a row holds.
        certificate: { type: file }
  notes: { type: text }
  # People in records (ADR 0122): who tests it, who reviews it, and when it's due.
  analyst:
    { type: person, role: analyst, assignment: { field: status, states: [received, in_testing] } }
  reviewer: { type: person, role: reviewer, assignment: { field: status, states: [in_review] } }
  helpers: { type: list, items: { type: person }, assignment: true, max_items: 5 }
  received_by: { type: person }
  due_on: { type: date }
  # Its state fields (ADR 0125): where it is in testing, and where it is.
  status:
    type: state
    initial: received
    states:
      received: { label: Received, set_by: [analyst] }
      in_testing: { label: In testing, set_by: [analyst, reviewer, qa], reason: optional }
      in_review: { label: In review, set_by: [analyst] }
      reviewed: { label: Reviewed, set_by: [reviewer], locks: true }
      released:
        label: Released
        set_by: [qa]
        locks: true
        reason: optional
        description: Its results can be used.
  custody:
    type: state
    initial: in_lab
    states:
      in_lab: { label: In the lab, set_by: [analyst, qa] }
      quarantined:
        { label: Quarantined, set_by: [qa], locks: true, reason: required, holds_amount: true }
      disposed: { label: Disposed, set_by: [qa], reason: required }
due: due_on
# What its records tell, and whom (ADR 0129).
notifications:
  in_review:
    label: Ready for review
    description: Reviewers hear when an analyst submits a sample's results for review.
    when: { field: status, to: in_review }
    tell: { roles: [reviewer], watchers: true }
    message:
      title: "{{ label }} is ready for review"
      body: "Purity {{ purity or 'not measured' }}, by {{ analyst or 'nobody' }}, on {{ protein or 'no protein' }}."
  released:
    label: Released
    description: Its analyst and whoever logged it hear when QA releases it.
    when: { field: status, from: [reviewed], to: [released] }
    tell: { fields: [analyst], creator: true }
    required: true
  quarantined:
    label: Quarantined
    when: { field: custody, to: quarantined }
    where: { field: due_on, op: gte, value: "{{ now }}" }
    tell: { fields: [received_by, helpers] }
    email: false
  relabelled:
    label: Its protein's LIMS ID changed
    when: { field: protein.lims_id }
    tell: { fields: [received_by] }
  logged:
    label: Logged
    when: { created: true }
    tell: { fields: [received_by] }
```
